## Sources/libewol/Config.in
```kconfig
menu "General"
	config __EWOL_APPL_BASIC_TITLE__
		prompt "Application Title"
		string
		default "Ewol Basic Title"
		help
			This is the application Title
	
endmenu
```

## sources/Config.in
```kconfig
menu "General"
	config __EWOL_APPL_BASIC_TITLE__
		prompt "Application Title"
		string
		default "Ewol Basic Title"
		help
			This is the application Title
	
	config __EWOL_INTEGRATED_FONT__
		prompt "Integrate Font in the appl data"
		bool
		default y
		help
			By default the application seach the font in the system folder.
			If enable the system seach the font in the "DATA:fonts" folder.
	
endmenu
```
